## build/Kconfig/Kconfig.shield.defconfig
```kconfig
osource "/media/abdullah/Development/Abdullah/projects/AircraftMonitoringDevice/Firmware/TestCodes/w25q_ext_flash/boards/shields/*/Kconfig.defconfig"
osource "/home/abdullah/ncs/v2.5.0/nrf/boards/shields/*/Kconfig.defconfig"
```

## build/w25q_ext_flash/Kconfig/Kconfig.shield
```kconfig
osource "/media/abdullah/Development/Abdullah/projects/AircraftMonitoringDevice/Firmware/TestCodes/w25q_ext_flash/boards/shields/*/Kconfig.shield"
osource "/home/abdullah/ncs/v2.9.0/nrf/boards/shields/*/Kconfig.shield"
```
